## sdkconfig.defaults
```kconfig
CONFIG_ESP_MAIN_TASK_STACK_SIZE=65536
CONFIG_ESP_SYSTEM_EVENT_TASK_STACK_SIZE=16384
CONFIG_ESP_WIFI_TASK_CORE_ID=0
CONFIG_ESP_WIFI_IRAM_OPT=y
CONFIG_ESP_WIFI_RX_IRAM_OPT=y
CONFIG_LWIP_TCPIP_TASK_STACK_SIZE=16384
CONFIG_ESP_WIFI_STATIC_RX_BUFFER_NUM=16
CONFIG_ESP_WIFI_DYNAMIC_RX_BUFFER_NUM=64
CONFIG_HTTPD_MAX_REQ_HDR_LEN=8192
CONFIG_HTTPD_MAX_URI_LEN=1024
CONFIG_HTTPD_MAX_RESP_HDR_LEN=4096
```
